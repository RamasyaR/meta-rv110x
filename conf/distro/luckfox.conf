## conf/distro/luckfox.conf
```bitbake
DISTRO = "luckfox"
DISTRO_VERSION = "1.0"

MAINTAINER = "Raman Rakavets <radikot88@gmail.com>"

# build with a small libc
TCLIBC = "musl"

# optimize for size
FULL_OPTIMIZATION = "-Os"

# Comment out any of the lines below to disable them in the build
# DISTRO_FEATURES options:
# alsa bluetooth ext2 pcmcia usbgadget usbhost wifi nfs zeroconf pci
DISTRO_FEATURES_NET = "ipv4 ipv6"
DISTRO_FEATURES_USB = "usbhost"
DISTRO_FEATURES_USBGADGET = "usbgadget vfat"

DISTRO_FEATURES = " \
    ${DISTRO_FEATURES_NET} \
    ${DISTRO_FEATURES_USB} \
    ${DISTRO_FEATURES_USBGADGET} \
"

# enable sysvinit for init
INIT_MANAGER = "sysvinit"

# drop native language support
USE_NLS="no"
# don't install locales into images
IMAGE_LINGUAS = ""
```

## conf/layer.conf
```bitbake
# We have a conf and classes directory, add to BBPATH
BBPATH .= ":${LAYERDIR}"

# We have recipes-* directories, add to BBFILES
BBFILES += "${LAYERDIR}/recipes-*/*.bb \
	        ${LAYERDIR}/recipes-*/*.bbappend \
            ${LAYERDIR}/recipes-*/*/*.bb \
	        ${LAYERDIR}/recipes-*/*/*.bbappend"

BBFILE_COLLECTIONS += "rv110x"
BBFILE_PATTERN_rv110x := "^${LAYERDIR}/"
BBFILE_PRIORITY_rv110x = "8"

RV110X_LICENSES = '${@os.path.normpath("${LAYERDIR}/licenses")}'
BB_BASEHASH_IGNORE_VARS:append = " RV110X_LICENSES"

# Additional license directories.
LICENSE_PATH += "${LAYERDIR}/licenses"

LAYERDEPENDS_rv110x = "core openembedded-layer rockchip"

# This should only be incremented on significant changes that will
# cause compatibility issues with other layers
LAYERVERSION_rv110x = "1"
LAYERSERIES_COMPAT_rv110x = "walnascar"
```

## conf/machine/include/rv-common.inc
```bitbake
KERNEL_FEATURES:append = " \
    bsp/rockchip/remove-non-rockchip-arch-arm.scc \
    bsp/rv/add-rv-specific-drivers.scc \
    bsp/rv/apply-rv-optimizations.scc \
    bsp/rv/remove-crypto-drivers.scc \
    bsp/rv/remove-drm-drivers.scc \
    bsp/rv/remove-gpio-drivers.scc \
    bsp/rv/remove-leds-drivers.scc \
    bsp/rv/remove-mfd-devices-support.scc \
    bsp/rv/remove-other-arch-drivers.scc \
    bsp/rv/remove-net-vendor-drivers.scc \
    bsp/rv/remove-regulator-drivers.scc \
    bsp/rv/remove-rtc-drivers.scc \
    bsp/rv/remove-serial-drivers.scc \
    bsp/rv/remove-snd-drivers.scc \
    bsp/rv/remove-usb-drivers.scc \
    bsp/rv/remove-wlan-drivers.scc \
"
```

## conf/machine/include/rv-ubifs.inc
```bitbake
# 'RV_SPI_NAND_STORAGE' indicates the user wants to use the
# ubifs configuration from this layer
OVERRIDES .= "${@ ':rv-ubifs' if bb.utils.to_boolean(d.getVar('RV_SPI_NAND_STORAGE'), False) else ''}"

UBOOT_CONFIG:rv-ubifs = "spi-nand"

UBI_VOLNAME = "rootfs"

UBOOT_EXTLINUX_ROOT:rv-ubifs = "ubi.mtd=rootfs root=ubi0:${UBI_VOLNAME}"
UBOOT_EXTLINUX_KERNEL_ARGS:rv-ubifs = "rootfstype=ubifs rootwait rw ${mtdparts}"

IMAGE_FSTYPES:remove:rv-ubifs = "wic${WIC_COMPRESSION_EXTENSION} wic.bmap"
IMAGE_FSTYPES:append:rv-ubifs = " ubi"
```

## conf/machine/include/rv1103.inc
```bitbake
SOC_FAMILY = "rv1103"

ROCKCHIP_CLOSED_TPL ?= "1"

require conf/machine/include/soc-family.inc
require conf/machine/include/rockchip-defaults.inc
require conf/machine/include/arm/armv7a/tune-cortexa7.inc
require conf/machine/include/rv-common.inc

SERIAL_CONSOLES = "115200;ttyS2"

KBUILD_DEFCONFIG = "multi_v7_defconfig"
KERNEL_IMAGETYPE ?= "zImage"

UBOOT_SUFFIX ?= "img"

MACHINE_FEATURES_BACKFILL_CONSIDERED += "rtc"

ENABLE_STATELESS_VPU_GST ?= "1"
```

## conf/machine/include/rv1106.inc
```bitbake
SOC_FAMILY = "rv1106"

ROCKCHIP_CLOSED_TPL ?= "1"

require conf/machine/include/soc-family.inc
require conf/machine/include/rockchip-defaults.inc
require conf/machine/include/arm/armv7a/tune-cortexa7.inc
require conf/machine/include/rv-common.inc
require conf/machine/include/rockchip-wic.inc

SERIAL_CONSOLES = "115200;ttyS2"

KBUILD_DEFCONFIG = "multi_v7_defconfig"
KERNEL_IMAGETYPE ?= "zImage"

UBOOT_SUFFIX ?= "img"

ENABLE_STATELESS_VPU_GST ?= "1"
```

## conf/machine/luckfox-pico-mini-a.conf
```bitbake
require conf/machine/include/rv1103.inc
require conf/machine/include/rockchip-wic.inc

MACHINE_EXTRA_RRECOMMENDS += "kernel-modules"

KERNEL_DEVICETREE = "rockchip/rv1103g-luckfox-pico-mini.dtb"
UBOOT_MACHINE = "luckfox-pico-mini-a-rv1103g_defconfig"

MACHINE_FEATURES += "usbhost usbgadget"
```

## conf/machine/luckfox-pico-mini-b.conf
```bitbake
require conf/machine/include/rv1103.inc
require conf/machine/include/rockchip-extlinux.inc

MACHINE_EXTRA_RRECOMMENDS += "kernel-modules"

KERNEL_DEVICETREE = "rockchip/rv1103g-luckfox-pico-mini.dtb"
UBOOT_MACHINE = "luckfox-pico-mini-b-rv1103g_defconfig"

MACHINE_FEATURES += "usbhost usbgadget"

SPL_BINARY ?= "idbloader.img"

UBI_VOLNAME = "rootfs"

UBOOT_EXTLINUX_ROOT = "ubi.mtd=rootfs root=ubi0:${UBI_VOLNAME}"
UBOOT_EXTLINUX_KERNEL_ARGS = "rootfstype=ubifs rootwait rw ${mtdparts}"

MKUBIFS_ARGS = "-F -m 2048 -e 124KiB -c 1020"
UBINIZE_ARGS = "-m 2048 -p 128KiB -O 2048"

IMAGE_FSTYPES += "ubi"
```

## conf/machine/luckfox-pico-mini.conf
```bitbake
require conf/machine/include/rv1103.inc
require conf/machine/include/rockchip-wic.inc
require conf/machine/include/rv-ubifs.inc

MACHINE_EXTRA_RRECOMMENDS += "kernel-modules"

KERNEL_DEVICETREE = "rockchip/rv1103g-luckfox-pico-mini.dtb"

UBOOT_CONFIG ??= "sdcard"
UBOOT_CONFIG[sdcard] = "luckfox-pico-mini-a-rv1103g_defconfig"
UBOOT_CONFIG[spi-nand] = "luckfox-pico-mini-b-rv1103g_defconfig"

MACHINE_FEATURES += "usbhost usbgadget"

MKUBIFS_ARGS = "-F -m 2048 -e 124KiB -c 1020"
UBINIZE_ARGS = "-m 2048 -p 128KiB -O 2048"
```

## recipes-bsp/u-boot/files/luckfox-pico-mini-a-rv1103g_defconfig
```kconfig
CONFIG_ARM=y
CONFIG_COUNTER_FREQUENCY=24000000
CONFIG_SYS_ARCH_TIMER=y
CONFIG_ARCH_ROCKCHIP=y
CONFIG_TEXT_BASE=0x00200000
CONFIG_SYS_MALLOC_F_LEN=0x80000
CONFIG_NR_DRAM_BANKS=1
CONFIG_HAS_CUSTOM_SYS_INIT_SP_ADDR=y
CONFIG_CUSTOM_SYS_INIT_SP_ADDR=0x00400000
CONFIG_DEFAULT_DEVICE_TREE="rv1103g-luckfox-pico-mini"
CONFIG_ROCKCHIP_RV1106=y
CONFIG_TARGET_EVB_RV1106=y
CONFIG_SPL_HAS_BSS_LINKER_SECTION=y
CONFIG_SPL_BSS_START_ADDR=0x001fe000
CONFIG_SPL_BSS_MAX_SIZE=0x20000
CONFIG_SYS_BOOTM_LEN=0x4000000
CONFIG_SYS_LOAD_ADDR=0x00e00800
CONFIG_DEBUG_UART_BASE=0xff4c0000
CONFIG_DEBUG_UART_CLOCK=24000000
CONFIG_SPL_LIBDISK_SUPPORT=y
CONFIG_DEBUG_UART=y
CONFIG_ANDROID_BOOT_IMAGE=y
CONFIG_BOOTDELAY=0
CONFIG_DEFAULT_FDT_FILE="rv1103g-luckfox-pico-mini.dtb"
# CONFIG_DISPLAY_CPUINFO is not set
CONFIG_DISPLAY_BOARDINFO_LATE=y
CONFIG_SPL_MAX_SIZE=0x28000
# CONFIG_SPL_RAW_IMAGE_SUPPORT is not set
CONFIG_SPL_MMC_WRITE=y
# CONFIG_CMD_ELF is not set
# CONFIG_CMD_IMI is not set
# CONFIG_CMD_XIMG is not set
CONFIG_CMD_GPT=y
# CONFIG_CMD_LOADB is not set
# CONFIG_CMD_LOADS is not set
CONFIG_CMD_MMC=y
# CONFIG_CMD_ITEST is not set
# CONFIG_CMD_SETEXPR is not set
# CONFIG_SPL_DOS_PARTITION is not set
CONFIG_OF_LIVE=y
CONFIG_OF_SPL_REMOVE_PROPS="clock-names interrupt-parent assigned-clocks assigned-clock-rates assigned-clock-parents"
CONFIG_SYS_RELOC_GD_ENV_ADDR=y
CONFIG_ROCKCHIP_GPIO=y
CONFIG_MMC_DW=y
CONFIG_MMC_DW_ROCKCHIP=y
CONFIG_DM_ETH_PHY=y
CONFIG_ETH_DESIGNWARE=y
CONFIG_GMAC_ROCKCHIP=y
CONFIG_RNG_ROCKCHIP=y
CONFIG_DEBUG_UART_SHIFT=2
CONFIG_SYS_NS16550_MEM32=y
CONFIG_ROCKCHIP_SFC=y
CONFIG_SYSRESET=y
CONFIG_SPL_TINY_MEMSET=y
CONFIG_ERRNO_STR=y
```

## recipes-kernel/linux/linux-yocto/defconfig
```kconfig
# CONFIG_LOCALVERSION_AUTO is not set
CONFIG_KERNEL_LZ4=y
CONFIG_SYSVIPC=y
CONFIG_NO_HZ_IDLE=y
CONFIG_HIGH_RES_TIMERS=y
CONFIG_LOG_BUF_SHIFT=14
CONFIG_CGROUPS=y
CONFIG_BLK_DEV_INITRD=y
CONFIG_CC_OPTIMIZE_FOR_SIZE=y
CONFIG_ARCH_ROCKCHIP=y
# CONFIG_VDSO is not set
CONFIG_VMSPLIT_3G_OPT=y
CONFIG_THUMB2_KERNEL=y
CONFIG_UACCESS_WITH_MEMCPY=y
CONFIG_CPU_FREQ=y
CONFIG_CPU_FREQ_DEFAULT_GOV_ONDEMAND=y
CONFIG_CPU_FREQ_GOV_USERSPACE=y
CONFIG_CPUFREQ_DT=y
CONFIG_CPU_IDLE=y
CONFIG_VFP=y
CONFIG_NEON=y
# CONFIG_SUSPEND is not set
CONFIG_JUMP_LABEL=y
# CONFIG_STACKPROTECTOR_STRONG is not set
# CONFIG_STRICT_KERNEL_RWX is not set
CONFIG_MODULES=y
CONFIG_MODULE_UNLOAD=y
CONFIG_PARTITION_ADVANCED=y
CONFIG_CMDLINE_PARTITION=y
# CONFIG_MQ_IOSCHED_KYBER is not set
CONFIG_KSM=y
CONFIG_DEFAULT_MMAP_MIN_ADDR=32768
CONFIG_CMA=y
CONFIG_NET=y
CONFIG_PACKET=y
CONFIG_UNIX=y
CONFIG_INET=y
# CONFIG_INET_DIAG is not set
CONFIG_IPV6=m
# CONFIG_IPV6_SIT is not set
CONFIG_DEVTMPFS=y
CONFIG_DEVTMPFS_MOUNT=y
CONFIG_OF_OVERLAY=y
CONFIG_BLK_DEV_LOOP=y
CONFIG_BLK_DEV_RAM=y
CONFIG_NETDEVICES=y
# CONFIG_NET_CORE is not set
# CONFIG_NET_VENDOR_ALACRITECH is not set
# CONFIG_NET_VENDOR_AMAZON is not set
# CONFIG_NET_VENDOR_AQUANTIA is not set
# CONFIG_NET_VENDOR_ARC is not set
# CONFIG_NET_VENDOR_BROADCOM is not set
# CONFIG_NET_VENDOR_CADENCE is not set
# CONFIG_NET_VENDOR_CAVIUM is not set
# CONFIG_NET_VENDOR_CIRRUS is not set
# CONFIG_NET_VENDOR_CORTINA is not set
# CONFIG_NET_VENDOR_EZCHIP is not set
# CONFIG_NET_VENDOR_FARADAY is not set
# CONFIG_NET_VENDOR_GOOGLE is not set
# CONFIG_NET_VENDOR_HISILICON is not set
# CONFIG_NET_VENDOR_HUAWEI is not set
# CONFIG_NET_VENDOR_INTEL is not set
# CONFIG_NET_VENDOR_MARVELL is not set
# CONFIG_NET_VENDOR_MELLANOX is not set
# CONFIG_NET_VENDOR_MICREL is not set
# CONFIG_NET_VENDOR_MICROCHIP is not set
# CONFIG_NET_VENDOR_MICROSEMI is not set
# CONFIG_NET_VENDOR_NI is not set
# CONFIG_NET_VENDOR_NATSEMI is not set
# CONFIG_NET_VENDOR_NETRONOME is not set
# CONFIG_NET_VENDOR_PENSANDO is not set
# CONFIG_NET_VENDOR_QUALCOMM is not set
# CONFIG_NET_VENDOR_RENESAS is not set
# CONFIG_NET_VENDOR_ROCKER is not set
# CONFIG_NET_VENDOR_SAMSUNG is not set
# CONFIG_NET_VENDOR_SEEQ is not set
# CONFIG_NET_VENDOR_SOLARFLARE is not set
# CONFIG_NET_VENDOR_SMSC is not set
# CONFIG_NET_VENDOR_SOCIONEXT is not set
CONFIG_STMMAC_ETH=y
# CONFIG_DWMAC_GENERIC is not set
# CONFIG_NET_VENDOR_SYNOPSYS is not set
# CONFIG_NET_VENDOR_VIA is not set
# CONFIG_NET_VENDOR_WIZNET is not set
# CONFIG_NET_VENDOR_XILINX is not set
# CONFIG_WLAN_VENDOR_ADMTEK is not set
# CONFIG_WLAN_VENDOR_ATH is not set
# CONFIG_WLAN_VENDOR_ATMEL is not set
# CONFIG_WLAN_VENDOR_BROADCOM is not set
# CONFIG_WLAN_VENDOR_INTEL is not set
# CONFIG_WLAN_VENDOR_INTERSIL is not set
# CONFIG_WLAN_VENDOR_MARVELL is not set
# CONFIG_WLAN_VENDOR_MEDIATEK is not set
# CONFIG_WLAN_VENDOR_MICROCHIP is not set
# CONFIG_WLAN_VENDOR_RALINK is not set
# CONFIG_WLAN_VENDOR_REALTEK is not set
# CONFIG_WLAN_VENDOR_RSI is not set
# CONFIG_WLAN_VENDOR_ST is not set
# CONFIG_WLAN_VENDOR_TI is not set
# CONFIG_WLAN_VENDOR_ZYDAS is not set
# CONFIG_WLAN_VENDOR_QUANTENNA is not set
CONFIG_INPUT_EVDEV=y
CONFIG_KEYBOARD_ADC=y
# CONFIG_KEYBOARD_ATKBD is not set
CONFIG_KEYBOARD_GPIO=y
CONFIG_KEYBOARD_GPIO_POLLED=y
# CONFIG_INPUT_MOUSE is not set
# CONFIG_SERIO is not set
# CONFIG_LEGACY_PTYS is not set
CONFIG_SERIAL_8250=y
CONFIG_SERIAL_8250_CONSOLE=y
CONFIG_SERIAL_8250_DW=y
CONFIG_HW_RANDOM=y
CONFIG_I2C_CHARDEV=y
CONFIG_I2C_RK3X=y
CONFIG_SPI=y
CONFIG_SPI_ROCKCHIP=y
CONFIG_SPI_ROCKCHIP_SFC=y
CONFIG_SPI_SPIDEV=y
# CONFIG_PTP_1588_CLOCK is not set
CONFIG_POWER_RESET=y
CONFIG_POWER_RESET_RESTART=y
CONFIG_SYSCON_REBOOT_MODE=y
CONFIG_POWER_SUPPLY=y
# CONFIG_HWMON is not set
CONFIG_THERMAL=y
CONFIG_THERMAL_GOV_USER_SPACE=y
CONFIG_CPU_THERMAL=y
CONFIG_ROCKCHIP_THERMAL=y
CONFIG_WATCHDOG=y
CONFIG_DW_WATCHDOG=y
CONFIG_REGULATOR_FIXED_VOLTAGE=y
CONFIG_REGULATOR_GPIO=y
CONFIG_REGULATOR_PWM=y
CONFIG_DRM=y
CONFIG_SOUND=y
CONFIG_SND=y
# CONFIG_SND_SUPPORT_OLD_API is not set
# CONFIG_SND_DRIVERS is not set
# CONFIG_SND_ARM is not set
# CONFIG_SND_SPI is not set
CONFIG_SND_SOC=y
CONFIG_SND_SOC_ROCKCHIP=y
CONFIG_SND_SOC_ROCKCHIP_I2S_TDM=y
CONFIG_SND_SIMPLE_CARD=y
CONFIG_MMC=y
# CONFIG_PWRSEQ_EMMC is not set
CONFIG_MMC_BLOCK_MINORS=32
CONFIG_MMC_DW=y
CONFIG_MMC_DW_ROCKCHIP=y
CONFIG_NEW_LEDS=y
CONFIG_LEDS_CLASS=y
CONFIG_LEDS_GPIO=y
CONFIG_LEDS_TRIGGERS=y
CONFIG_LEDS_TRIGGER_ACTIVITY=y
CONFIG_RTC_CLASS=y
CONFIG_DMADEVICES=y
CONFIG_PL330_DMA=y
# CONFIG_VIRTIO_MENU is not set
# CONFIG_VHOST_MENU is not set
# CONFIG_ARM_ARCH_TIMER_EVTSTREAM is not set
CONFIG_EXTCON=y
CONFIG_IIO=y
CONFIG_ROCKCHIP_SARADC=y
CONFIG_PWM=y
CONFIG_PWM_ROCKCHIP=y
CONFIG_NVMEM_ROCKCHIP_OTP=y
CONFIG_EXT4_FS=y
CONFIG_EXPORTFS_BLOCK_OPS=y
# CONFIG_DNOTIFY is not set
CONFIG_VFAT_FS=y
CONFIG_EXFAT_FS=y
CONFIG_TMPFS=y
CONFIG_SQUASHFS=y
# CONFIG_SQUASHFS_ZLIB is not set
CONFIG_SQUASHFS_XZ=y
CONFIG_SQUASHFS_4K_DEVBLK_SIZE=y
CONFIG_NFS_FS=y
CONFIG_NFS_V3_ACL=y
CONFIG_NFS_V4=y
CONFIG_NLS_CODEPAGE_437=y
CONFIG_NLS_ISO8859_1=y
CONFIG_CRYPTO_ZSTD=y
# CONFIG_CRYPTO_HW is not set
CONFIG_DMA_CMA=y
CONFIG_CMA_SIZE_MBYTES=0
CONFIG_PRINTK_TIME=y
CONFIG_DEBUG_FS=y
# CONFIG_RUNTIME_TESTING_MENU is not set
```
