// SPDX-License-Identifier: (GPL-2.0+ OR MIT)
/*
 * Copyright (c) 2023 Luckfox Electronics Co., Ltd.
 */

/dts-v1/;

#include "rv1103g-luckfox-pico-mini.dtsi"

/ {
	model = "Luckfox Pico Mini A";
	compatible = "rockchip,rv1103g-luckfox-pico-mini-a", "rockchip,rv1103";	
};
